## conf/layer.conf
```bitbake
# We have a conf and classes directory, add to BBPATH
BBPATH .= ":${LAYERDIR}"

# We have recipes-* directories, add to BBFILES
BBFILES += "${LAYERDIR}/recipes-*/*/*.bb \
            ${LAYERDIR}/recipes-*/*/*.bbappend"

BBFILE_COLLECTIONS += "mender-kernel-rpi"
BBFILE_PATTERN_mender-kernel = "^${LAYERDIR}/"
# PRIOERITY needs to be higher than community-raspberrypi (10) to win the boot.scr battle
BBFILE_PRIORITY_mender-kernel = "11"

LAYERDEPENDS_mender-kernel-rpi  = "                           \
                                core                          \
                                mender                        \
                                mender-kernel                 \
                                mender-raspberrypi            \
                              "
LAYERSERIES_COMPAT_mender-kernel-rpi = "scarthgap"
```
